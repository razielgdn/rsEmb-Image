## boards/aml-s905x-cc/conf/bblayers.conf
```bitbake
# BBLAYERS configuration for AML-S905X-CC (Libre Computer)
BBLAYERS ?= " \
  /home/yocto/workspace/poky/meta \
  /home/yocto/workspace/poky/meta-poky \
  /home/yocto/workspace/meta-openembedded/meta-oe \
  /home/yocto/workspace/meta-amlogic \
"
BBLAYERS_NON_REMOVABLE ?= " \
  /home/yocto/workspace/poky/meta \
  /home/yocto/workspace/poky/meta-poky \
"
```

## boards/rpi4/conf/bblayers.conf
```bitbake
# BBLAYERS configuration for Raspberry Pi 4. 
# This file was created to the project RisingembeddedMx-Yocto

# POKY_BBLAYERS_CONF_VERSION is increased each time build/conf/bblayers.conf
# changes incompatibly
POKY_BBLAYERS_CONF_VERSION = "2"

BBPATH = "${TOPDIR}"
BBFILES ?= ""
#  /home/yocto/workspace/boards/rpi4/meta-openembedded/meta-oe \
BBLAYERS ?= " \
  /home/yocto/workspace/boards/rpi4/poky/meta \
  /home/yocto/workspace/boards/rpi4/poky/meta-poky \
  /home/yocto/workspace/boards/rpi4/poky/meta-yocto-bsp \
  /home/yocto/workspace/boards/rpi4/meta-raspberrypi \
  "
BBLAYERS_NON_REMOVABLE ?= " \
  /home/yocto/workspace/boards/rpi4/poky/meta \
  /home/yocto/workspace/boards/rpi4/poky/meta-poky \
"
```

## boards/rpi4/meta-rising-embedded-os/conf/distro/rising-embedded-os.conf
```bitbake
# I need to improve this file, explain the lines to generate readability and maintainability. 
# This file is the configuration for the Rising Embedded OS distribution, 
# which is built on top of the Poky distribution. It defines various settings 
# and features for the distribution, such as the name, version, features, 
# and package management configuration. The file also includes some specific configurations 
# for the Raspberry Pi 4 board, such as enabling UART and disabling Bluetooth. 

MAINTAINER = "octavioraziel.gdn@gmail.com"
require conf/distro/poky.conf

# Set the distribution name, version, and codename
DISTRO = "rising-embedded-os"
DISTRO_NAME = "Rising-Embedded-MX-OS"
DISTRO_VERSION = "1.0"
DISTRO_CODENAME = "OLINUX"
# Remove unnecessary features to reduce image size
DISTRO_FEATURES:remove = " \ 
                sysvinit \
                pcmcia \
                wayland \
                ext2 \
                irda \
                x11 \
                nfc \
                ptest \
                3g \
                pulseaudio \
                alsa-plugins \
                opengl \
                egl \
                "

# Add only essential features  
DISTRO_FEATURES:append = " \ 
                systemd \
                wifi \
                pam \
                usrmerge \
                "

# We need to backfill sysvinit for compatibility with some packages that expect it. 
DISTRO_FEATURES_BACKFILL_CONSIDERED += "sysvinit "

# Set the default init system to systemd
VIRTUAL-RUNTIME_init_manager = "systemd "
VIRTUAL-RUNTIME_initscripts = "systemd-compat-units "

# Set the root home directory  
ROOT_HOME = "/root "
# Accept the license for the synaptics-killswitch and commercial packages, 
# which are required by some of the packages in this distribution.
LICENSE_FLAGS_ACCEPTED += "synaptics-killswitch commercial"

# Set default hostname 
hostname_pn-base-files = "risingembeddedmx"

# Set the default locale and language settings for the image
GLIBC_GENERATE_LOCALES = "en_US.UTF-8"
IMAGE_LINGUAS = "en-us"

# Avoid installing recommended packages 
NO_RECOMMENDATIONS = "1"

# Set default timezone
DEFAULT_TIMEZONE = "America/Monterrey" 

# Enable UART
ENABLE_UART = "1"
```

## boards/rpi4/meta-rising-embedded-os/conf/layer.conf
```bitbake
# We have a conf and classes directory, add to BBPATH
BBPATH .= ":${LAYERDIR}"

# We have recipes-* directories, add to BBFILES
BBFILES += "${LAYERDIR}/recipes-*/*/*.bb \
            ${LAYERDIR}/recipes-*/*/*.bbappend"

BBFILE_COLLECTIONS += "rising-embedded-os-layer"
BBFILE_PATTERN_rising-embedded-os-layer = "^${LAYERDIR}/"
BBFILE_PRIORITY_rising-embedded-os-layer = "6"

LAYERDEPENDS_rising-embedded-os-layer = "core"
LAYERSERIES_COMPAT_rising-embedded-os-layer = "scarthgap" 
```
